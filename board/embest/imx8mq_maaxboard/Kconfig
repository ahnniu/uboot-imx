## board/embest/imx8mq_maaxboard/Kconfig
```kconfig
if TARGET_IMX8MQ_DDR4_MAAXBOARD

config SYS_BOARD
	default "imx8mq_maaxboard"

config SYS_VENDOR
	default "embest"

config SYS_CONFIG_NAME
	default "imx8mq_maaxboard"

choice
	prompt "MaaXBoard DDR4 select"

config MAAXBOARD_DDR4_HYNIX_2GB
	bool "SK Hynix 2GB DDR4"

config MAAXBOARD_DDR4_HYNIX_4GB
	bool "SK Hynix 4GB DDR4"

endchoice

endif
```
